## west.yml
```yaml
# The west manifest file for upstream Zephyr.
#
# The per-installation west configuration file, .west/config, sets the
# path to the project containing this file in the [manifest] section's
# "path" variable.
#
# You are free to create your own manifest files and put them in any
# repository you want, to create your own custom Zephyr installations.
# For example, you could create a manifest file in your own out of
# tree application directory, which would pull this zephyr repository
# in as an ordinary project.
#
# You can pass your manifest repositories to west init when creating a
# new Zephyr installation. See the west documentation for more
# information.

manifest:
  defaults:
    remote: upstream

  remotes:
    - name: upstream
      url-base: https://github.com/zephyrproject-rtos
    - name: babblesim
      url-base: https://github.com/BabbleSim

  group-filter: [-babblesim, -optional]

  #
  # Please add items below based on alphabetical order
  # zephyr-keep-sorted-start re(^\s+\- name:)
  projects:
    - name: acpica
      revision: 8d24867bc9c9d81c81eeac59391cda59333affd4
      path: modules/lib/acpica
    - name: cmsis
      revision: 512cc7e895e8491696b61f7ba8066b4a182569b8
      path: modules/hal/cmsis
      groups:
        - hal
    - name: cmsis-dsp
      revision: d80a49b2bb186317dc1db4ac88da49c0ab77e6e7
      path: modules/lib/cmsis-dsp
    - name: cmsis-nn
      revision: e9328d612ea3ea7d0d210d3ac16ea8667c01abdd
      path: modules/lib/cmsis-nn
    - name: cmsis_6
      repo-path: CMSIS_6
      revision: 06d952b6713a2ca41c9224a62075e4059402a151
      path: modules/hal/cmsis_6
      groups:
        - hal
    - name: edtt
      revision: b9ca3c7030518f07b7937dacf970d37a47865a76
      path: tools/edtt
      groups:
        - tools
    - name: fatfs
      revision: 16245c7c41d2b79e74984f49b5202551786b8a9b
      path: modules/fs/fatfs
      groups:
        - fs
    - name: hal_rpi_pico
      path: modules/hal/rpi_pico
      revision: 7b57b24588797e6e7bf18b6bda168e6b96374264
      groups:
        - hal
    - name: hal_st
      revision: 9f81b4427e955885398805b7bca0da3a8cd9109c
      path: modules/hal/st
      groups:
        - hal
    - name: hal_stm32
      revision: 1e753266ddfb4b07a8a0b1ec566e9637ea45d5ef
      path: modules/hal/stm32
      groups:
        - hal
    - name: hal_tdk
      revision: 6727477af1e46fa43878102489b9672a9d24e39f
      path: modules/hal/tdk
      groups:
        - hal
    - name: hal_ti
      revision: bc8e7b99bb668cc51a3aa384448a48c48a33f8e2
      path: modules/hal/ti
      groups:
        - hal
    - name: hal_wurthelektronik
      revision: e3e2797b224fc48fdef1bc3e5a12a7c73108bba2
      path: modules/hal/wurthelektronik
      groups:
        - hal
    - name: hostap
      path: modules/lib/hostap
      revision: e942f86e865d5b24bbbe8b0c333f030cbbe62bfb
    - name: liblc3
      revision: 48bbd3eacd36e99a57317a0a4867002e0b09e183
      path: modules/lib/liblc3
    - name: libmctp
      revision: b97860e78998551af99931ece149eeffc538bdb1
      path: modules/lib/libmctp
    - name: libmetal
      revision: 91d38634d1882f0a2151966f8c5c230ce1c0de7b
      path: modules/hal/libmetal
      groups:
        - hal
    - name: littlefs
      path: modules/fs/littlefs
      groups:
        - fs
      revision: 8f5ca347843363882619d8f96c00d8dbd88a8e79
    - name: loramac-node
      revision: fb00b383072518c918e2258b0916c996f2d4eebe
      path: modules/lib/loramac-node
    - name: lvgl
      revision: b03edc8e6282a963cd312cd0b409eb5ce263ea75
      path: modules/lib/gui/lvgl
    - name: mbedtls
      revision: 85440ef5fffa95d0e9971e9163719189cf34d979
      path: modules/crypto/mbedtls
      groups:
        - crypto
    - name: mcuboot
      revision: 4eba8087fa606db801455f14d185255bc8c49467
      path: bootloader/mcuboot
      groups:
        - bootloader
    - name: mipi-sys-t
      path: modules/debug/mipi-sys-t
      groups:
        - debug
      revision: 33e5c23cbedda5ba12dbe50c4baefb362a791001
    - name: net-tools
      revision: 986bfeb040df3d9029366de8aea4ce1f84e93780
      path: tools/net-tools
      groups:
        - tools
    - name: nrf_wifi
      revision: 5f59c2336c69f28ae83f93812a1d726f9fceabfe
      path: modules/lib/nrf_wifi
    - name: open-amp
      revision: c30a6d8b92fcebdb797fc1a7698e8729e250f637
      path: modules/lib/open-amp
    - name: openthread
      revision: 3ae741f95e7dfb391dec35c48742862049eb62e8
      path: modules/lib/openthread
    - name: percepio
      path: modules/debug/percepio
      revision: 49e6dc202aa38c2a3edbafcc2dab85dec6aee973
      groups:
        - debug
    - name: picolibc
      path: modules/lib/picolibc
      revision: 560946f26db075c296beea5b39d99e6de43c9010
    - name: segger
      revision: cf56b1d9c80f81a26e2ac5727c9cf177116a4692
      path: modules/debug/segger
      groups:
        - debug
    - name: tinycrypt
      revision: 1012a3ebee18c15ede5efc8332ee2fc37817670f
      path: modules/crypto/tinycrypt
      groups:
        - crypto
    - name: trusted-firmware-a
      revision: 713ffbf96c5bcbdeab757423f10f73eb304eff07
      path: modules/tee/tf-a/trusted-firmware-a
      groups:
        - tee
    - name: trusted-firmware-m
      revision: 021e2bbd50c215e41710a72e05abce3224f074a7
      path: modules/tee/tf-m/trusted-firmware-m
      groups:
        - tee
    - name: uoscore-uedhoc
      revision: 54abc109c9c0adfd53c70077744c14e454f04f4a
      path: modules/lib/uoscore-uedhoc
    - name: zcbor
      revision: 9b07780aca6fb21f82a241ba386ad9b379809337
      path: modules/lib/zcbor
  # zephyr-keep-sorted-stop

  self:
    path: zephyr
    west-commands: scripts/west-commands.yml
    import: submanifests
```
